/*
 * DA2TASK3_ASM.asm
 *
 *  Created: 3/7/2016 5:40:38 PM
 *   Author: erl25_000
 */ 


 SBI	DDRB, 1
 SBI	DDRB,0
 SBI	DDRB, 2
 SBI	DDRB, 3
 SBI	DDRB, 4
 SBI	DDRB, 5
 SBI	DDRB, 6
 SBI	DDRB, 7
 LDI	R21, 0

BEGIN:
 LDI	R20, 0x07
 STS	OCR1AH, R20
 LDI	R20, 0xA1
 STS	OCR1AL, R20

 LDI	R20, 0x00
 STS	TCCR1A, R20
 LDI	R20, 0x0D
 STS	TCCR1B, R20

 INC	R21
 Out	PORTB, R21
 
L1:
 IN		R20, TIFR1
 SBRS	R20, OCF1A
 RJMP	L1
 LDI	R20, 0
 STS	TCCR1B, R20
 LDI	R20, 1<<OCF1A
 OUT	TIFR1, R20
 LDI	R20, 0x07
 STS	OCR1AH, R20
 LDI	R20, 0xA1
 STS	OCR1AL, R20
 LDI	R20, 0x00
 STS	TCCR1A, R20
 LDI	R20, 0X0D
 STS	TCCR1B, R20
L2:
 IN		R20, TIFR1
 SBRS	R20, OCF1A
 RJMP	L2
 LDI	R20, 0
 STS	TCCR1B, R20
 LDI	R20, 1<<OCF1A
 OUT	TIFR1, R20
 JMP	BEGIN

